## dts/bindings/input/azoteq,iqs9151.yaml
```yaml
description: |
  Azoteq IQS9151 trackpad driver.

compatible: "azoteq,iqs9151"

include: i2c-device.yaml

properties:
  irq-gpios:
    type: phandle-array
    required: true
    description: Interrupt GPIO for IQS9151 RDY pin (active-low).
  reset-gpios:
    type: phandle-array
    required: false
    description: Optional hardware reset GPIO for IQS9151 MCLR pin (active-low).
```
