## tests/iqs9151_work_cb/testcase.yaml
```yaml
tests:
  iqs9151.work_cb:
    tags:
      - iqs9151
      - input
    platform_allow:
      - qemu_cortex_m3
      - native_sim
      - native_sim_64
```
